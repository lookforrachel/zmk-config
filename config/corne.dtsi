/ {    
    bottom_encoder: bottom_encoder {
        compatible = "alps,ec11";
        label = "BOTTOM_ENCODER";
        a-gpios = <&gpio0 10 (GPIO_ACTIVE_HIGH | GPIO_PULL_UP)>;
        b-gpios = <&gpio0 9 (GPIO_ACTIVE_HIGH | GPIO_PULL_UP)>;
        steps = <15>;
    };

    sensors: sensors {
        compatible = "zmk,keymap-sensors";
        sensors = <&bottom_encoder &top_encoder>;
        triggers-per-rotation = <30>;
    };
};